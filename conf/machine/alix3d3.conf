## conf/machine/alix3d3.conf
```bitbake
#@TYPE: Machine
#@NAME: alix3d3

#@DESCRIPTION: Machine configuration for alix3d3 systems

require conf/machine/include/tune-i586.inc

IMAGE_CLASSES += "hdd_image-alix"

PREFERRED_PROVIDER_virtual/kernel = "linux-yocto"
PREFERRED_VERSION_linux-yocto = "3.8%"

KERNEL_IMAGETYPE = "bzImage"
IMAGE_FSTYPES = "ext3 alix-hddimage"

MACHINE_FEATURES = "screen keyboard pci usbhost ext2 ext3 x86 \
                    acpi serial usbgadget alsa"

MACHINE_EXTRA_RRECOMMENDS += "kernel-modules"

# FIXME: Need to add xorg-video-geode driver.

# now. Look at extensions, should we need all of them?
XSERVER = "xserver-xorg \
           xf86-input-mouse \
           xf86-input-keyboard \
           xf86-input-evdev \
           xf86-input-synaptics \
           xserver-xorg-extension-glx \
           "

APPEND += "lxfb.mode_option=1024x768@60 debugshell=5"

# The board has a serial console but also VGA. We use VGA for console and
# we don't want getty to bind on the serial (sysvinit-inittab) as the
# serial port can be used for other purposes.
#
# Enable this option if you want to have serial console. It is good for
# debugging the kernel if you have a kernel panic.
# SERIAL_CONSOLE ?= "115200 ttyS0"
```
